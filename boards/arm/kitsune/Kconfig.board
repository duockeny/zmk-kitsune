## boards/arm/kitsune/Kconfig.board
```kconfig
config BOARD_KITSUNE
    bool "Kitsune Keyboard"
    depends on SOC_STM32F072XB
    imply RETAINED_MEM
    imply RETENTION
    imply RETENTION_BOOT_MODE
```

## boards/arm/kitsune/Kconfig.defconfig
```kconfig
if BOARD_KITSUNE

config BOARD
    default "kitsune"

config ZMK_KEYBOARD_NAME
    default "Kitsune"

config ZMK_USB
    default y

config ZMK_USB
    default y

config ZMK_KSCAN_MATRIX_POLLING
    default y

endif # BOARD_KITSUNE
```

## boards/arm/kitsune/board.yml
```yaml
board:
  name: kitsune
  full_name: Kitsune
  vendor: artifact
  socs:
  - name: stm32f072xb
```

## boards/arm/kitsune/kitsune_defconfig
```kconfig
CONFIG_BOARD_KITSUNE=y
CONFIG_SOC_SERIES_STM32F0X=y
CONFIG_SOC_STM32F072XB=y

# Enable clock
CONFIG_CLOCK_CONTROL=y
CONFIG_SYS_CLOCK_HW_CYCLES_PER_SEC=48000000

# Enable GPIO
CONFIG_GPIO=y

# Enable pinctrl
CONFIG_PINCTRL=y

# Needed to reduce this to size that will fit on F072 more easily
CONFIG_KERNEL_MEM_POOL=n
CONFIG_HEAP_MEM_POOL_SIZE=0

# ZMK Settings
CONFIG_ZMK_KSCAN_MATRIX_POLLING=y
CONFIG_ZMK_USB=y
CONFIG_ZMK_STUDIO=y

# Boot Retention Settings
CONFIG_RETAINED_MEM=y
CONFIG_RETENTION=y
CONFIG_RETENTION_BOOT_MODE=y

# ZMK Studio Settings
CONFIG_ZMK_BEHAVIOR_LOCAL_ID_TYPE_CRC16=y
CONFIG_ZMK_STUDIO_RPC_THREAD_STACK_SIZE=2048
CONFIG_ZMK_STUDIO_RPC_TX_BUF_SIZE=32
CONFIG_ZMK_KEYMAP_LAYER_NAME_MAX_LEN=10
CONFIG_FLASH=y
CONFIG_FLASH_MAP=y
CONFIG_NVS=y

# Zephyr Memory Reduction Settings
CONFIG_IDLE_STACK_SIZE=128
CONFIG_ISR_STACK_SIZE=756
CONFIG_MAIN_STACK_SIZE=756
CONFIG_USB_CDC_ACM_RINGBUF_SIZE=128
CONFIG_USB_WORKQUEUE_STACK_SIZE=756

# ZMK Memory Reduction Settings
CONFIG_ZMK_BEHAVIOR_HOLD_TAP_MAX_HELD=3
CONFIG_ZMK_BEHAVIOR_HOLD_TAP_MAX_CAPTURED_EVENTS=10
CONFIG_ZMK_BEHAVIOR_STICKY_KEY_MAX_HELD=3
CONFIG_ZMK_BEHAVIORS_QUEUE_SIZE=8
CONFIG_ZMK_COMBO_MAX_PRESSED_COMBOS=1
CONFIG_ZMK_COMBO_MAX_COMBOS_PER_KEY=1
CONFIG_ZMK_COMBO_MAX_KEYS_PER_COMBO=2
```
